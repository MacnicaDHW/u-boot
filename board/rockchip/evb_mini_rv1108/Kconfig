## board/rockchip/evb_mini_rv1108/Kconfig
```kconfig
if TARGET_EVB_MINI_RV1108

config SYS_BOARD
	default "evb_mini_rv1108"

config SYS_VENDOR
	default "rockchip"

config SYS_CONFIG_NAME
	default "evb_mini_rv1108"

config BOARD_SPECIFIC_OPTIONS # dummy
	def_bool y

endif
```
